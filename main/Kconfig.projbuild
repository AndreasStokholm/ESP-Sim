## main/Kconfig.projbuild
```kconfig
menu "ESP-Sim DASH pod"

config ESPSIM_TZ
    string "Time zone (POSIX TZ)"
    default "UTC0"
    help
        The pod reports its activation date and time in this zone, as a
        real pod reports the PDM's local time. Example: "CST6CDT,M3.2.0,M11.1.0".

config ESPSIM_AP_SSID_PREFIX
    string "Access point name prefix"
    default "ESP-Sim-Pod"
    help
        With no Wi-Fi network saved, the board runs an access point named
        this plus the end of its MAC address. Its password is printed on the
        serial console at boot.

endmenu
```

## sdkconfig.defaults
```kconfig
CONFIG_IDF_TARGET="esp32s3"
CONFIG_ESPTOOLPY_FLASHSIZE_8MB=y
CONFIG_PARTITION_TABLE_SINGLE_APP_LARGE=y
CONFIG_ESP_CONSOLE_USB_SERIAL_JTAG=y

# Bluetooth: NimBLE, one phone at a time, peripheral only
CONFIG_BT_ENABLED=y
CONFIG_BT_NIMBLE_ENABLED=y
CONFIG_BT_NIMBLE_MAX_CONNECTIONS=1
CONFIG_BT_NIMBLE_ROLE_CENTRAL=n
CONFIG_BT_NIMBLE_ROLE_OBSERVER=n
CONFIG_BT_NIMBLE_ROLE_PERIPHERAL=y
CONFIG_BT_NIMBLE_ROLE_BROADCASTER=y
CONFIG_BT_NIMBLE_ATT_PREFERRED_MTU=251
CONFIG_BT_NIMBLE_MSYS_1_BLOCK_COUNT=24
CONFIG_BT_NIMBLE_SVC_GAP_DEVICE_NAME=" :: Fake POD ::"
CONFIG_BT_NIMBLE_LOG_LEVEL_WARNING=y

# Wi-Fi alongside Bluetooth, for the control panel
CONFIG_ESP_COEX_SW_COEXIST_ENABLE=y
CONFIG_HTTPD_MAX_REQ_HDR_LEN=1024

CONFIG_LOG_DEFAULT_LEVEL_INFO=y
CONFIG_ESP_MAIN_TASK_STACK_SIZE=6144
```
